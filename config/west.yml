## modules/npm1300_vbat/drivers/sensor/npm1300_vbat/Kconfig
```kconfig
# SPDX-License-Identifier: MIT

config ZMK_NPM1300_VBAT
	bool "Nordic nPM1300 battery protection and ZMK adapter"
	default y
	depends on DT_HAS_ZMK_NPM1300_VBAT_ENABLED
	select I2C
	help
	  Run Nordic's host-side fuel gauge for ZMK state-of-charge reporting and
	  protect the cell with an independent raw-voltage monitor.

if ZMK_NPM1300_VBAT

config ZMK_NPM1300_INIT_PRIORITY
	int
	default 91

config ZMK_NPM1300_WARNING_MV
	int "Voltage at which nonessential loads are disabled"
	default 3500
	range 2800 4200

config ZMK_NPM1300_SHIP_MV
	int "Voltage at which ship mode is entered"
	default 3200
	range 2800 4200

config ZMK_NPM1300_RECOVERY_MV
	int "Voltage required to clear the low-battery warning"
	default 3600
	range 2800 4200

config ZMK_NPM1300_MONITOR_INTERVAL_SECONDS
	int "Raw-voltage protection polling interval"
	default 5
	range 1 300

config ZMK_NPM1300_FUEL_GAUGE_ACTIVE_INTERVAL_MS
	int "Fuel-gauge interval while active on battery"
	default 2000
	range 250 60000

config ZMK_NPM1300_FUEL_GAUGE_IDLE_INTERVAL_MS
	int "Fuel-gauge interval while idle on battery"
	default 10000
	range 250 300000

config ZMK_NPM1300_FUEL_GAUGE_CHARGING_INTERVAL_MS
	int "Fuel-gauge interval while externally powered"
	default 500
	range 250 60000

config ZMK_NPM1300_FUEL_GAUGE_ASSUMED_TEMP_C
	int "Assumed cell temperature when no thermistor is fitted"
	default 22
	range -20 60

config ZMK_NPM1300_WARNING_CONFIRM_SAMPLES
	int "Consecutive low-voltage samples required to disable nonessential loads"
	default 3
	range 1 10

config ZMK_NPM1300_SHIP_CONFIRM_SAMPLES
	int "Consecutive critical samples required for ship mode"
	default 3
	range 1 10

endif
```

## modules/npm1300_vbat/dts/bindings/sensor/zmk,npm1300-vbat.yml
```yaml
# SPDX-License-Identifier: MIT
description: nPM1300 host fuel gauge, low-voltage protection, and ZMK battery adapter

compatible: "zmk,npm1300-vbat"

include: sensor-device.yaml

properties:
  charger:
    type: phandle
    required: true
    description: nPM1300 charger sensor used to obtain battery and VBUS state

  pmic:
    type: phandle
    required: true
    description: Parent nPM1300 MFD used to request ship mode

  ext-power:
    type: phandle
    required: true
    description: External-power device controlling the nonessential RGB rail
```

## modules/npm1300_vbat/tests/testcase.yaml
```yaml
tests:
  npm1300_vbat.thresholds:
    type: unit
    platform_allow:
      - native_sim
      - native_sim/native/64
    integration_platforms:
      - native_sim
    tags:
      - battery
      - ztest
```
