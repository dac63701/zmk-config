## boards/arm/60wkeyboard/60wkeyboard_nrf52840_zmk_defconfig
```kconfig
CONFIG_ARM_MPU=y
CONFIG_PINCTRL=y
CONFIG_GPIO=y
CONFIG_USE_DT_CODE_PARTITION=y
CONFIG_BUILD_OUTPUT_UF2=y
```

## boards/arm/60wkeyboard/Kconfig.60wkeyboard
```kconfig
config BOARD_NICE60
    select SOC_NRF52840_QIAA
    select ZMK_BOARD_COMPAT if BOARD_NICE60_NRF52840_ZMK
    imply RETAINED_MEM if BOARD_NICE60_NRF52840_ZMK
    imply RETENTION if BOARD_NICE60_NRF52840_ZMK
    imply RETENTION_BOOT_MODE if BOARD_NICE60_NRF52840_ZMK
```

## boards/arm/60wkeyboard/Kconfig.defconfig
```kconfig
if BOARD_60WKEYBOARD

config ZMK_KEYBOARD_NAME
    default "60wkeyboard"

if USB_DEVICE_STACK

config USB_NRFX
    default y

endif # USB_DEVICE_STACK

config BT_CTLR
    default BT

endif # BOARD_60WKEYBOARD
```

## boards/arm/60wkeyboard/board.yml
```yaml
board:
  name: 60wkeyboard
  vendor: custom
  socs:
    - name: nrf52840
      variants:
        - name: zmk
```
